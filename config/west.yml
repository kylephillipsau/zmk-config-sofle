## config/west.yml
```yaml
manifest:
  remotes:
    - name: zmkfirmware
      url-base: https://github.com/zmkfirmware
    - name: cormoran
      url-base: https://github.com/cormoran
    - name: zzeneg
      url-base: https://github.com/zzeneg
  projects:
    - name: zmk
      remote: cormoran
      revision: v0.3-branch+dya
      import: app/west.yml
    - name: zmk-behavior-runtime-sensor-rotate
      remote: cormoran
      revision: main
    - name: zmk-module-ble-management
      remote: cormoran
      revision: zmk-v0.3.0.0
    - name: zmk-module-battery-history
      remote: cormoran
      revision: main
    - name: zmk-module-settings-rpc
      remote: cormoran
      revision: main
    - name: zmk-module-runtime-input-processor
      remote: cormoran
      revision: zmk-v0.3.0.0
    # A vendor-defined HID interface, for Windows: it won't let an app set a keyboard's lights
    # (host/windows)
    - name: zmk-raw-hid
      remote: zzeneg
      revision: 6a37765dfab6197292e7a9f47305dcf87386d56a
  self:
    path: config
```
